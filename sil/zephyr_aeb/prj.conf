## CMakeLists.txt
```
# SPDX-License-Identifier: Apache-2.0
#
# AEB System — Zephyr Application
#
# Compiles the repo C code as a Zephyr app targeting native_sim
# with SocketCAN on vcan0.

cmake_minimum_required(VERSION 3.20.0)

find_package(Zephyr REQUIRED HINTS $ENV{ZEPHYR_BASE})
project(aeb_zephyr C)

# ── Repo C source files (cloned from AEB-stellantis-project) ──────────────
set(AEB_REPO ${CMAKE_CURRENT_SOURCE_DIR}/repo)

target_include_directories(app PRIVATE
    ${AEB_REPO}/include
    ${CMAKE_CURRENT_SOURCE_DIR}/src
)

target_sources(app PRIVATE
    # Zephyr-specific
    src/main.c
    src/can_hal_zephyr.c

    # Application modules (from repo)
    ${AEB_REPO}/src/perception/aeb_perception.c
    ${AEB_REPO}/src/decision/aeb_ttc.c
    ${AEB_REPO}/src/decision/aeb_fsm.c
    ${AEB_REPO}/src/execution/aeb_pid.c
    ${AEB_REPO}/src/execution/aeb_alert.c
    ${AEB_REPO}/src/communication/aeb_can.c
    ${AEB_REPO}/src/communication/aeb_uds.c
    ${AEB_REPO}/src/integration/aeb_core.c
)
```

## prj.conf
```kconfig
# AEB Zephyr Application
# Target: native_sim with TCP CAN bus via POSIX sockets + pthread

CONFIG_MAIN_STACK_SIZE=4096
CONFIG_LOG=y
CONFIG_LOG_DEFAULT_LEVEL=3
CONFIG_PRINTK=y
CONFIG_SYS_CLOCK_TICKS_PER_SEC=1000

# POSIX threading support (for CAN RX pthread)
CONFIG_PTHREAD_IPC=y

# Enable floating point in log/printf (needed for LOG_INF with %f)
CONFIG_CBPRINTF_FP_SUPPORT=y
```

## boards/native_sim.overlay
```dts
/* DTS overlay for native_sim — no SocketCAN needed (using TCP CAN bus) */
```

## src/main.c
```c
/**
 * @file  main.c
 * @brief AEB Zephyr main — 10 ms execution cycle on native_sim.
 *
 * On native_sim, uses usleep for the 10ms tick since the POSIX
 * RX pthread doesn't integrate with Zephyr's simulated clock.
 * On real hardware, replace usleep with k_timer + k_sem.
 */

#include <zephyr/kernel.h>
#include <zephyr/logging/log.h>
#include <unistd.h>

#include "aeb_core.h"
#include "aeb_types.h"

LOG_MODULE_REGISTER(aeb_main, LOG_LEVEL_INF);

extern void can_hal_drain_rx(void *can_state);

static aeb_core_state_t aeb_state;

int main(void)
{
    int32_t rc;

    LOG_INF("=== AEB ECU (Zephyr native_sim) ===");
    LOG_INF("Cycle: 10 ms | TCP CAN bus");

    rc = aeb_core_init(&aeb_state);
    if (rc != 0) {
        LOG_ERR("AEB core init failed: %d", rc);
        return rc;
    }

    LOG_INF("AEB system initialised — entering main loop");

    uint32_t cycle_count = 0U;

    while (1) {
        usleep(10000);  /* 10 ms — matches NFR-PERF-001 */

        can_hal_drain_rx(&aeb_state.can);

        can_rx_data_t can_rx;
        can_get_rx_data(&aeb_state.can, &can_rx);

        raw_sensor_input_t raw = {0};
        raw.radar_d     = can_rx.target_distance;
        raw.radar_vr    = can_rx.relative_speed;
        raw.lidar_d     = can_rx.target_distance;
        raw.v_ego       = can_rx.vehicle_speed;
        raw.can_timeout = can_rx.rx_timeout_flag;
        raw.fi          = 0U;

        aeb_core_step(&aeb_state, &raw);

        cycle_count++;
        if ((cycle_count % 50U) == 0U) {
            LOG_INF("c=%u st=%u ttc=%.1f brk=%.0f%% d=%.1f v=%.1f flt=%u to=%u",
                    cycle_count,
                    (unsigned)aeb_state.fsm.fsm_state,
                    (double)aeb_state.ttc.ttc,
                    (double)aeb_state.pid.brake_pct,
                    (double)aeb_state.perception.distance,
                    (double)can_rx.vehicle_speed,
                    (unsigned)aeb_state.perception.fault_flag,
                    (unsigned)can_rx.rx_timeout_flag);
        }
    }

    return 0;
}
```

## src/can_hal.h
```c
/**
 * @file  can_hal.h
 * @brief CAN HAL interface — shared between stub and Zephyr implementation.
 *
 * This is a local copy matching the repo's stubs/can_hal.h.
 * The implementation is in can_hal_zephyr.c (real Zephyr CAN driver).
 */

#ifndef CAN_HAL_H
#define CAN_HAL_H

#include <stdint.h>

#define CAN_BAUD_500K   500000U

int32_t can_hal_init(uint32_t baud_rate);
int32_t can_hal_add_rx_filter(uint32_t msg_id);
int32_t can_hal_send(uint32_t id, const uint8_t *data, uint8_t dlc);

#endif /* CAN_HAL_H */
```

## src/can_hal_zephyr.c
```c
/**
 * @file  can_hal_zephyr.c
 * @brief CAN HAL — TCP virtual CAN bus for Docker SIL.
 *
 * Uses POSIX sockets directly (native_sim is a Linux process).
 * RX runs in a pthread to avoid interfering with the main loop.
 *
 * Wire format: 16 bytes [4B ID | 1B DLC | 3B pad | 8B data]
 */

#include "can_hal.h"
#include <zephyr/kernel.h>
#include <zephyr/logging/log.h>
#include <string.h>
#include <stdio.h>
#include <errno.h>
#include <sys/socket.h>
#include <netinet/in.h>
#include <arpa/inet.h>
#include <unistd.h>
#include <stdlib.h>
#include <pthread.h>

LOG_MODULE_REGISTER(can_hal, LOG_LEVEL_INF);

#define CAN_TCP_DEFAULT_HOST "127.0.0.1"
#define CAN_TCP_DEFAULT_PORT 29536
#define CAN_TCP_FRAME_SIZE   16

struct can_tcp_frame {
    uint32_t id;
    uint8_t  dlc;
    uint8_t  pad[3];
    uint8_t  data[8];
};

static int sock_fd = -1;

/* RX ring buffer (lock-free single producer single consumer) */
#define RX_QUEUE_SIZE 128

struct rx_item {
    uint32_t id;
    uint8_t  data[8];
    uint8_t  dlc;
};

static struct rx_item rx_queue[RX_QUEUE_SIZE];
static volatile int rx_head = 0;
static volatile int rx_tail = 0;

/* RX pthread (not Zephyr thread — avoids scheduler conflicts) */
static pthread_t rx_pthread;

static void *rx_thread_fn(void *arg)
{
    (void)arg;
    LOG_INF("CAN RX pthread started");

    while (1) {
        uint8_t buf[CAN_TCP_FRAME_SIZE];
        int total = 0;

        while (total < CAN_TCP_FRAME_SIZE) {
            int n = recv(sock_fd, buf + total, CAN_TCP_FRAME_SIZE - total, 0);
            if (n <= 0) {
                usleep(100000);
                total = 0;
                continue;
            }
            total += n;
        }

        struct can_tcp_frame *frame = (struct can_tcp_frame *)buf;
        int next = (rx_head + 1) % RX_QUEUE_SIZE;
        if (next != rx_tail) {
            rx_queue[rx_head].id  = frame->id;
            rx_queue[rx_head].dlc = frame->dlc;
            uint8_t len = (frame->dlc <= 8U) ? frame->dlc : 8U;
            memcpy(rx_queue[rx_head].data, frame->data, len);
            rx_head = next;
        }
    }
    return NULL;
}

/* ── Public API ────────────────────────────────────────────────────────── */

int32_t can_hal_init(uint32_t baud_rate)
{
    (void)baud_rate;

    const char *host = getenv("CAN_TCP_HOST");
    const char *port_str = getenv("CAN_TCP_PORT");
    if (host == NULL) { host = CAN_TCP_DEFAULT_HOST; }
    int port = (port_str != NULL) ? atoi(port_str) : CAN_TCP_DEFAULT_PORT;

    LOG_INF("Connecting to CAN TCP bus at %s:%d", host, port);

    /* Note: Zephyr's POSIX subset on native_sim does not expose
     * getaddrinfo()/<netdb.h>, so the host MUST be a dotted IPv4 literal.
     * The Docker entrypoint resolves the service name with `getent hosts`
     * before launching the ECU and exports CAN_TCP_HOST as an IP. */

    for (int attempt = 0; attempt < 30; attempt++) {
        sock_fd = socket(AF_INET, SOCK_STREAM, 0);
        if (sock_fd < 0) {
            LOG_ERR("socket() failed: %d", errno);
            usleep(1000000);
            continue;
        }

        struct sockaddr_in addr;
        memset(&addr, 0, sizeof(addr));
        addr.sin_family = AF_INET;
        addr.sin_port = htons((uint16_t)port);

        if (inet_pton(AF_INET, host, &addr.sin_addr) != 1) {
            LOG_WRN("Invalid IP: %s (attempt %d)", host, attempt + 1);
            close(sock_fd);
            sock_fd = -1;
            usleep(1000000);
            continue;
        }

        int ret = connect(sock_fd, (struct sockaddr *)&addr, sizeof(addr));
        if (ret == 0) {
            LOG_INF("CAN TCP connected (fd=%d)", sock_fd);
            pthread_create(&rx_pthread, NULL, rx_thread_fn, NULL);
            return 0;
        }

        LOG_WRN("Connect attempt %d failed (errno=%d)", attempt + 1, errno);
        close(sock_fd);
        sock_fd = -1;
        usleep(1000000);
    }

    LOG_ERR("CAN TCP connection failed after 30 attempts");
    return -1;
}

int32_t can_hal_add_rx_filter(uint32_t msg_id)
{
    (void)msg_id;
    return 0;
}

int32_t can_hal_send(uint32_t id, const uint8_t *data, uint8_t dlc)
{
    if (sock_fd < 0 || data == NULL) {
        return -1;
    }

    struct can_tcp_frame frame;
    memset(&frame, 0, sizeof(frame));
    frame.id  = id;
    frame.dlc = dlc;
    uint8_t len = (dlc <= 8U) ? dlc : 8U;
    memcpy(frame.data, data, len);

    int n = send(sock_fd, &frame, sizeof(frame), MSG_NOSIGNAL);
    if (n != (int)sizeof(frame)) {
        return -1;
    }

    return 0;
}

/* ── Drain RX queue ────────────────────────────────────────────────────── */

extern void can_rx_process(void *state, uint32_t id,
                           const uint8_t *data, uint8_t dlc);

void can_hal_drain_rx(void *can_state)
{
    while (rx_tail != rx_head) {
        struct rx_item *item = &rx_queue[rx_tail];
        can_rx_process(can_state, item->id, item->data, item->dlc);
        rx_tail = (rx_tail + 1) % RX_QUEUE_SIZE;
    }
}
```
