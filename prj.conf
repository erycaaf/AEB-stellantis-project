## CMakeLists.txt
```
# ===========================================================================
# CMakeLists.txt — AEB System for Zephyr RTOS
# ===========================================================================
# Project: Autonomous Emergency Braking (AEB)
# Version: 1.0 (Sprint 0 — Project Skeleton)
# Standard: MISRA C:2012, ISO 26262 ASIL B
# ===========================================================================

cmake_minimum_required(VERSION 3.20.0)

# --- Zephyr project setup ---------------------------------------------------
# In a full Zephyr environment, find_package(Zephyr) sets up the toolchain,
# kernel, and devicetree. For PC-based compilation and unit testing without
# Zephyr SDK, we fall back to a standard C project.
# ---------------------------------------------------------------------------
find_package(Zephyr QUIET)

if(Zephyr_FOUND)
    # ---- Zephyr build (target hardware / QEMU) ----------------------------
    project(aeb_system LANGUAGES C)

    target_include_directories(app PRIVATE
        ${CMAKE_CURRENT_SOURCE_DIR}/include
    )

    target_sources(app PRIVATE
        # Entry point
        src/main.c

        # Task A — Perception
        src/perception/aeb_perception.c

        # Task B — Decision Logic
        src/decision/aeb_ttc.c
        src/decision/aeb_fsm.c

        # Task C — Execution
        src/execution/aeb_pid.c
        src/execution/aeb_alert.c

        # Task D — CAN Bus
        src/communication/aeb_can.c

        # Task E — UDS Diagnostics
        src/communication/aeb_uds.c
    )

else()
    # ---- Native / PC build (GCC, unit testing) ----------------------------
    project(aeb_system LANGUAGES C)

    # Strict MISRA-aligned warnings
    set(CMAKE_C_STANDARD 11)
    set(CMAKE_C_STANDARD_REQUIRED ON)
    set(CMAKE_C_EXTENSIONS OFF)

    add_compile_options(
        -Wall
        -Wextra
        -Wpedantic
        -Werror
        -Wshadow
        -Wconversion
        -Wdouble-promotion
        -Wformat=2
        -Wundef
        -fno-common
    )

    # Include path
    include_directories(${CMAKE_CURRENT_SOURCE_DIR}/include)

    # ---- Main application library (all modules) ---------------------------
    add_library(aeb_modules STATIC
        src/perception/aeb_perception.c
        src/decision/aeb_ttc.c
        src/decision/aeb_fsm.c
        src/execution/aeb_pid.c
        src/execution/aeb_alert.c
        src/communication/aeb_can.c
        src/communication/aeb_uds.c
    )

    # ---- Main executable --------------------------------------------------
    add_executable(aeb_main src/main.c)
    target_link_libraries(aeb_main PRIVATE aeb_modules)

    # ---- Unit test executables (one per module) ---------------------------
    # Tests are added as they are implemented during Sprint 1.
    # Example:
    #   add_executable(test_pid tests/test_pid.c)
    #   target_link_libraries(test_pid PRIVATE aeb_modules)
    #
    #   add_executable(test_alert tests/test_alert.c)
    #   target_link_libraries(test_alert PRIVATE aeb_modules)

endif()
```

## prj.conf
```kconfig
# ===========================================================================
# prj.conf — Zephyr RTOS configuration for AEB System
# ===========================================================================
# This file enables the Zephyr subsystems required by the AEB application.
# Adjust board-specific settings in boards/<board>.overlay.
# ===========================================================================

# --- Kernel and threading ---------------------------------------------------
CONFIG_MAIN_STACK_SIZE=4096
CONFIG_SYSTEM_WORKQUEUE_STACK_SIZE=2048
CONFIG_HEAP_MEM_POOL_SIZE=0

# Cooperative threads (no preemption within same priority)
CONFIG_NUM_COOP_PRIORITIES=16
CONFIG_NUM_PREEMPT_PRIORITIES=0

# Timer for 10 ms periodic execution (NFR-PERF-001)
CONFIG_SYS_CLOCK_TICKS_PER_SEC=1000

# --- CAN bus (FR-CAN-001 to FR-CAN-004) ------------------------------------
CONFIG_CAN=y
CONFIG_CAN_MAX_FILTER=8

# --- GPIO (alert outputs: visual + audible) ---------------------------------
CONFIG_GPIO=y

# --- Logging (development only, disable for production) ---------------------
CONFIG_LOG=y
CONFIG_LOG_DEFAULT_LEVEL=3
CONFIG_LOG_BUFFER_SIZE=1024

# --- Safety: no dynamic allocation (NFR-COD-002) ---------------------------
CONFIG_HEAP_MEM_POOL_SIZE=0

# --- Shell (optional, for debug during development) -------------------------
# CONFIG_SHELL=y
# CONFIG_SHELL_BACKEND_SERIAL=y
```

## src/main.c
```c
/**
 * @file    main.c
 * @brief   AEB system entry point — STUB implementation (Sprint 0).
 * @owner   Task E (Rian Ithalo da Costa Linhares)
 *
 * @details In the final implementation, this file will:
 *          - Initialise all modules
 *          - Configure Zephyr threads and k_timer (10 ms)
 *          - Run the main execution cycle
 *          - Manage mutexes for shared data
 *
 * @todo    Implement Zephyr threading model, timer, and integration.
 */

#include "aeb_types.h"
#include "aeb_config.h"
#include "aeb_perception.h"
#include "aeb_ttc.h"
#include "aeb_fsm.h"
#include "aeb_pid.h"
#include "aeb_alert.h"
#include "aeb_can.h"
#include "aeb_uds.h"

/**
 * @brief Application entry point.
 *
 * Initialises all AEB modules. In the full implementation,
 * this will set up Zephyr threads and the 10 ms timer.
 *
 * @return 0 on success.
 */
int main(void)
{
    /* Initialise all modules */
    perception_init();
    fsm_init();
    pid_init();
    (void)can_init();
    uds_init();

    /*
     * STUB: In full implementation, this will:
     * 1. Create k_timer for 10 ms periodic execution
     * 2. Create thread_perception (priority 1)
     * 3. Create thread_controller (priority 2)
     * 4. Create thread_communication (priority 3)
     * 5. Enter Zephyr scheduler
     */

    return 0;
}
```

## include/aeb_alert.h
```c
/**
 * @file    aeb_alert.h
 * @brief   Alert mapping and driver override detection — public API.
 * @module  Execution — Alert mapping and driver override detection
 * @version 1.1
 * @date    2026-04-10
 *
 * @details Maps FSM state to visual/audible alert outputs and detects
 *          driver override conditions. Derived from Simulink chart_79
 *          (Alert_Map) and chart_88 (Override_Det).
 *
 * @requirements FR-ALR-001 to FR-ALR-004, FR-DEC-006, FR-DEC-007
 * @simulink     chart_79 (Alert_Map) — system_137.xml
 *               chart_88 (Override_Det) — system_144.xml
 */

#ifndef AEB_ALERT_H
#define AEB_ALERT_H

#include "aeb_types.h"

/* ── Alert enumerations (used by alert_map) ───────────────────────────── */

/** @brief Alert type: visual, audible, or both. */
typedef enum
{
    ALERT_NONE    = 0,   /**< No alert active.                          */
    ALERT_VISUAL  = 1,   /**< Visual alert only (dashboard indicator).  */
    ALERT_AUDIBLE = 2,   /**< Audible alert only (buzzer/beep).         */
    ALERT_BOTH    = 3    /**< Visual + audible alert.                   */
} alert_type_e;

/**
 * @brief Buzzer command pattern mapped from FSM state.
 *
 * @note Enum values do NOT follow severity order. The values are
 *       assigned to match the Simulink Alert_Map (chart_79) output
 *       encoding. The mapping to FSM states is:
 *         SILENT(0)     -> OFF, STANDBY, POST_BRAKE
 *         SINGLE(1)     -> WARNING
 *         DOUBLE(2)     -> BRAKE_L1
 *         CONTINUOUS(3) -> BRAKE_L3  (highest severity)
 *         FAST_PULSE(4) -> BRAKE_L2
 */
typedef enum
{
    BUZZER_SILENT     = 0,   /**< No sound — OFF / STANDBY / POST_BRAKE. */
    BUZZER_SINGLE     = 1,   /**< Single beep — WARNING state.           */
    BUZZER_DOUBLE     = 2,   /**< Double beep — BRAKE_L1 state.          */
    BUZZER_CONTINUOUS = 3,   /**< Continuous beep — BRAKE_L3 state.      */
    BUZZER_FAST_PULSE = 4    /**< Fast pulse — BRAKE_L2 state.           */
} buzzer_cmd_e;

/**
 * @brief Map FSM state to alert output signals.
 *
 * Mapping (from Simulink Alert_Map):
 *   OFF / STANDBY    -> ALERT_NONE,  BUZZER_SILENT
 *   WARNING          -> ALERT_BOTH,  BUZZER_SINGLE
 *   BRAKE_L1         -> ALERT_BOTH,  BUZZER_DOUBLE
 *   BRAKE_L2         -> ALERT_BOTH,  BUZZER_FAST_PULSE
 *   BRAKE_L3         -> ALERT_BOTH,  BUZZER_CONTINUOUS
 *   POST_BRAKE       -> ALERT_NONE,  BUZZER_SILENT
 *
 * @param[in]  fsm_state  Current FSM state (fsm_state_e value).
 * @param[out] output     Pointer to alert output struct (must not be NULL).
 *
 * @requirement FR-ALR-001, FR-ALR-002, FR-ALR-004
 */
void alert_map(const uint8_t fsm_state, alert_output_t *output);

/**
 * @brief Detect driver override condition.
 *
 * Override is active when:
 *   - brake_pedal != 0, OR
 *   - |steering_angle| > STEERING_OVERRIDE_DEG (5 degrees)
 *
 * @note In POST_BRAKE state, only the accelerator pedal triggers override
 *       (FR-FSM-006). This function handles the general case; the FSM
 *       module applies the POST_BRAKE exception externally.
 *
 * @param[in] steering_angle  Steering wheel angle [degrees].
 * @param[in] brake_pedal     Brake pedal status: 0=released, 1=pressed.
 * @return    1 if override detected, 0 otherwise.
 *
 * @requirement FR-DEC-006, FR-DEC-007
 */
uint8_t override_detect(const float32_t steering_angle, const uint8_t brake_pedal);

#endif /* AEB_ALERT_H */
```

## include/aeb_can.h
```c
/**
 * @file  aeb_can.h
 * @brief CAN Bus Communication module — public API.
 *
 * Implements FR-CAN-001..004 from the AEB SRS v2.0.
 * Designed for Zephyr RTOS CAN driver; MISRA C:2012 compliant.
 *
 * @author  Renato Fagundes
 * @date    2026-04-07
 */

#ifndef AEB_CAN_H
#define AEB_CAN_H

#include "aeb_types.h"
#include "aeb_config.h"
#include "aeb_uds.h"
#include <stdint.h>

/* ── CAN Message IDs (from aeb_system.dbc) ───────────────────────────── */
#define CAN_ID_BRAKE_CMD      (0x080U)   /**< 128  — AEB_BrakeCmd   TX    */
#define CAN_ID_EGO_VEHICLE    (0x100U)   /**< 256  — AEB_EgoVehicle RX    */
#define CAN_ID_DRIVER_INPUT   (0x101U)   /**< 257  — AEB_DriverInput RX   */
#define CAN_ID_RADAR_TARGET   (0x120U)   /**< 288  — AEB_RadarTarget RX   */
#define CAN_ID_FSM_STATE      (0x200U)   /**< 512  — AEB_FSMState   TX    */
#define CAN_ID_ALERT          (0x300U)   /**< 768  — AEB_Alert      TX    */
#define CAN_ID_UDS_REQUEST    (0x7DFU)   /**< 2015 — UDS_Request    RX    */
#define CAN_ID_UDS_RESPONSE   (0x7E8U)   /**< 2024 — UDS_Response   TX    */

/* ── CAN Frame Lengths (bytes) ───────────────────────────────────────── */
#define CAN_DLC_BRAKE_CMD     (4U)
#define CAN_DLC_EGO_VEHICLE   (8U)
#define CAN_DLC_DRIVER_INPUT  (4U)
#define CAN_DLC_RADAR_TARGET  (8U)
#define CAN_DLC_FSM_STATE     (4U)
#define CAN_DLC_ALERT         (2U)
#define CAN_DLC_UDS_REQUEST   (4U)
#define CAN_DLC_UDS_RESPONSE  (8U)

/* ── RX Timeout ──────────────────────────────────────────────────────── */
#define CAN_RX_TIMEOUT_CYCLES (3U)  /**< 3 missed frames → fault        */

/* ── Alive counter ───────────────────────────────────────────────────── */
#define ALIVE_COUNTER_MAX     (15U) /**< 4-bit rolling counter 0..15     */

/* ── Return codes ────────────────────────────────────────────────────── */
#define CAN_OK                (0)
#define CAN_ERR_INIT          (-1)
#define CAN_ERR_TX            (-2)
#define CAN_ERR_TIMEOUT       (-3)

/**
 * @brief Raw sensor data decoded from CAN RX frames.
 *
 * Populated by can_rx_process() from AEB_EgoVehicle (0x100) and
 * AEB_RadarTarget (0x120).  Consumed by the Perception module.
 */
typedef struct
{
    /* From AEB_RadarTarget (0x120) */
    float32_t target_distance;   /**< [m]                                */
    float32_t relative_speed;    /**< [m/s]                              */
    float32_t ttc_radar;         /**< [s]   (info only)                  */
    uint8_t   confidence_raw;    /**< 0..15                              */

    /* From AEB_EgoVehicle (0x100) */
    float32_t vehicle_speed;     /**< [m/s]                              */
    float32_t long_accel;        /**< [m/s^2]                            */
    float32_t yaw_rate;          /**< [deg/s]                            */
    float32_t steering_angle;    /**< [deg]                              */

    /* From AEB_DriverInput (0x101) */
    uint8_t   brake_pedal;       /**< [%] 0..100                         */
    uint8_t   accel_pedal;       /**< [%] 0..100                         */
    uint8_t   aeb_enable;        /**< 0/1                                */
    uint8_t   driver_override;   /**< 0/1                                */

    /* From UDS_Request (0x7DF) — FR-UDS-005
     *
     * Concurrency contract (IMPORTANT on Zephyr target):
     *   can_rx_process()           writes uds_request_pending = 1 from the
     *                              CAN RX callback context.
     *   aeb_core_step()            reads-and-clears it from the 10 ms cycle
     *                              thread.
     *
     *   On the host stub the two are called sequentially from the same
     *   thread, so there is no race.  On the real Zephyr driver the RX
     *   callback runs in a separate context; the driver integration layer
     *   MUST serialise access — either by marshalling RX frames into a
     *   message queue consumed by the core tick, by protecting this flag
     *   with an atomic operation / brief interrupt disable around the
     *   read-and-clear pair, or equivalent.
     *
     *   Without such synchronisation, a request arriving between the
     *   read of uds_request_pending and the call to
     *   can_clear_uds_request_pending() is silently dropped.  This is
     *   not catchable at unit-test level because the host stub never
     *   exercises the race — hence the documentation here. */
    uds_request_t uds_request;         /**< Decoded UDS request frame    */
    uint8_t       uds_request_pending; /**< 1 when a new request arrived;
                                            cleared by can_clear_uds_request_pending()
                                            after the response transmits. */

    /* Status */
    uint8_t   rx_timeout_flag;   /**< 1 if radar RX timed out            */
} can_rx_data_t;

/**
 * @brief Internal state of the CAN module (opaque to other modules).
 */
typedef struct
{
    uint8_t   alive_counter;       /**< 4-bit TX rolling counter         */
    uint8_t   rx_miss_count;       /**< Consecutive missed RX frames     */
    uint32_t  tx_cycle_counter;    /**< Counts 10 ms ticks for 50 ms TX  */
    uint8_t   initialised;         /**< 1 after successful can_init()    */
    can_rx_data_t  last_rx;        /**< Most recent decoded RX data      */
} can_state_t;

/* ═══════════════════════════════════════════════════════════════════════
 *  PUBLIC API
 * ═══════════════════════════════════════════════════════════════════════ */

/**
 * @brief Initialise CAN peripheral at 500 kbit/s and register RX filters.
 *
 * @param[out] state  Module state, zeroed before first call.
 * @return CAN_OK on success, CAN_ERR_INIT on failure.
 *
 * @req FR-CAN-004  Baud rate 500 kbit/s.
 */
int32_t can_init(can_state_t *state);

/**
 * @brief Process a single received CAN frame (called from RX callback).
 *
 * Decodes EgoVehicle (0x100), RadarTarget (0x120), DriverInput (0x101)
 * or UDS_Request (0x7DF) per DBC layout.  Resets the RX miss counter
 * on valid radar frame.  A valid 0x7DF frame sets uds_request_pending.
 *
 * @param[in,out] state  Module state.
 * @param[in]     id     CAN message ID.
 * @param[in]     data   Pointer to frame payload (up to 8 bytes).
 * @param[in]     dlc    Data Length Code.
 *
 * @req FR-CAN-002  Receive radar target data.
 * @req FR-CAN-003  DBC signal encoding.
 * @req FR-UDS-005  Receive UDS request on 0x7DF.
 */
void can_rx_process(can_state_t *state,
                    uint32_t     id,
                    const uint8_t *data,
                    uint8_t      dlc);

/**
 * @brief Check RX timeout — call once per 10 ms cycle.
 *
 * Increments miss counter; sets rx_timeout_flag after 3 consecutive
 * misses (≥ 60 ms with 20 ms radar period).
 *
 * @param[in,out] state  Module state.
 *
 * @req FR-CAN-002  Timeout detection (acceptance: 3 × 20 ms = 60 ms).
 */
void can_check_timeout(can_state_t *state);

/**
 * @brief Transmit AEB_BrakeCmd (0x080) — every 10 ms cycle.
 *
 * @param[in,out] state    Module state (alive counter incremented).
 * @param[in]     pid_out  PID brake output from the PID module.
 * @param[in]     fsm_out  FSM output from the FSM module.
 * @return CAN_OK on success, CAN_ERR_TX on failure.
 *
 * @req FR-CAN-003  DBC signal encoding.
 */
int32_t can_tx_brake_cmd(can_state_t       *state,
                         const pid_output_t *pid_out,
                         const fsm_output_t *fsm_out);

/**
 * @brief Transmit AEB_FSMState (0x200) — every 50 ms (5 × 10 ms ticks).
 *
 * @param[in,out] state    Module state (cycle counter checked).
 * @param[in]     fsm_out  FSM output from the FSM module.
 * @return CAN_OK if transmitted, 1 if not yet due, CAN_ERR_TX on failure.
 *
 * @req FR-CAN-001  Transmit ego dynamics at fixed cycle.
 */
int32_t can_tx_fsm_state(can_state_t       *state,
                         const fsm_output_t *fsm_out);

/**
 * @brief Transmit AEB_Alert (0x300) — event-driven, call when alert changes.
 *
 * @param[in] alert_out  Alert output from the Alert module.
 * @return CAN_OK on success, CAN_ERR_TX on failure.
 *
 * @req FR-CAN-003  DBC signal encoding.
 */
int32_t can_tx_alert(const alert_output_t *alert_out);

/**
 * @brief Get a copy of the latest decoded RX data.
 *
 * @param[in]  state  Module state.
 * @param[out] out    Destination struct.
 */
void can_get_rx_data(const can_state_t *state,
                     can_rx_data_t     *out);

/**
 * @brief Transmit a UDS response frame on CAN_ID_UDS_RESPONSE (0x7E8).
 *
 * Packs the 8-byte uds_response_t into a CAN frame and sends via HAL.
 * Called from aeb_core_step() after uds_process_request() produces a
 * response for a pending 0x7DF request.
 *
 * @param[in] resp  UDS response to transmit.
 * @return CAN_OK on success, CAN_ERR_TX on failure.
 *
 * @req FR-UDS-005  UDS request/response via CAN within one cycle.
 */
int32_t can_tx_uds_response(const uds_response_t *resp);

/**
 * @brief Mark the current UDS request as serviced and clear the pending flag.
 *
 * The caller (aeb_core_step) is responsible for deciding *when* to call
 * this — typically only after can_tx_uds_response() has confirmed the
 * response transmitted successfully. Clearing the flag on TX failure
 * silently drops the response and forces the requester into a P2_server
 * timeout (ISO 14229-2 §6.3) instead of a best-effort retry at the ECU
 * level. See aeb_core.c step 10 for the retry policy.
 *
 * Must be called exactly once per successfully-serviced request to
 * prevent double-processing on the next cycle.
 *
 * @param[in,out] state  Module state.
 */
void can_clear_uds_request_pending(can_state_t *state);

/* ── Signal encode/decode helpers (FR-CAN-003) ───────────────────────── */

/**
 * @brief Pack an unsigned integer signal into a CAN frame payload.
 *
 * @param[out] data       Frame payload buffer.
 * @param[in]  start_bit  LSB bit position (Intel / little-endian).
 * @param[in]  length     Signal length in bits (1..32).
 * @param[in]  raw_value  Unsigned raw value to pack.
 */
void can_pack_signal(uint8_t *data,
                     uint8_t  start_bit,
                     uint8_t  length,
                     uint32_t raw_value);

/**
 * @brief Unpack an unsigned integer signal from a CAN frame payload.
 *
 * @param[in]  data       Frame payload buffer.
 * @param[in]  start_bit  LSB bit position (Intel / little-endian).
 * @param[in]  length     Signal length in bits (1..32).
 * @return Unsigned raw value.
 */
uint32_t can_unpack_signal(const uint8_t *data,
                           uint8_t        start_bit,
                           uint8_t        length);

#endif /* AEB_CAN_H */
```

## include/aeb_config.h
```c
/**
 * @file  aeb_config.h
 * @brief Calibration parameters for the AEB system (NFR-POR-002).
 *
 * All tuneable parameters centralised here, enabling independent
 * calibration without modifying source code.
 *
 * Based on AEB_Tasks v1.0 Section 3.2.
 *
 * @req NFR-POR-002 Calibration separated from code.
 * @req FR-COD-001 Structural correspondence with Simulink model.
 *
 * @version 2.0 — Integration
 * @date 2026-04
 */

#ifndef AEB_CONFIG_H
#define AEB_CONFIG_H

/* ===== Timing (NFR-PERF-001) ===== */
#define AEB_CYCLE_TIME_MS     10U        /**< 100 Hz                  */
#define AEB_DT                0.01F      /**< 10 ms in seconds        */

/* ===== TTC thresholds (FR-DEC-004) ===== */
#define TTC_WARNING           4.0F       /**< s                       */
#define TTC_BRAKE_L1          3.0F       /**< s                       */
#define TTC_BRAKE_L2          2.2F       /**< s                       */
#define TTC_BRAKE_L3          1.8F       /**< s                       */
#define TTC_MAX               10.0F      /**< s — saturation          */
#define V_REL_MIN             0.5F       /**< m/s                     */

/* ===== Distance floors (Table 10) ===== */
#define D_FLOOR_L1            20.0F      /**< m                       */
#define D_FLOOR_L2            10.0F      /**< m                       */
#define D_FLOOR_L3            5.0F       /**< m                       */

/* ===== Speed range (FR-DEC-008) ===== */
#define V_EGO_MIN             2.78F      /**< m/s = 10 km/h           */
#define V_EGO_MAX             16.67F     /**< m/s = 60 km/h           */

/* ===== Deceleration levels ===== */
#define DECEL_L1              2.0F       /**< m/s^2                   */
#define DECEL_L2              4.0F       /**< m/s^2                   */
#define DECEL_L3              6.0F       /**< m/s^2 (= amax)          */

/* ===== Hysteresis & timing ===== */
#define HYSTERESIS_TIME       0.2F       /**< s — de-escalation       */
#define WARNING_MIN_TIME      0.8F       /**< s — FR-ALR-003          */
#define POST_BRAKE_HOLD       2.0F       /**< s — FR-BRK-005          */
#define V_STOP_THRESHOLD      0.01F      /**< m/s                     */

/* ===== PI controller (FR-BRK-002) ===== */
#define PID_KP                10.0F
#define PID_KI                0.05F
#define PID_INTEG_MAX         50.0F      /**< % — anti-windup         */
#define BRAKE_OUT_MAX         100.0F     /**< %                       */
#define BRAKE_OUT_MIN         0.0F       /**< %                       */
#define MAX_JERK              10.0F      /**< m/s^3                   */

/* ===== Sensor fault (FR-PER-007) ===== */
#define SENSOR_FAULT_CYCLES   3U         /**< consecutive bad cycles  */
#define DIST_ROC_LIMIT        10.0F      /**< m/cycle                 */
#define VEL_ROC_LIMIT         2.0F       /**< m/s per cycle           */
#define STEERING_OVERRIDE_DEG 5.0F       /**< degrees                 */

/* ===== CAN (FR-CAN-001..004) ===== */
#define CAN_BAUD_RATE         500000U    /**< 500 kbit/s              */
#define CAN_TX_PERIOD_MS      50U        /**< ego dynamics TX period  */
#define CAN_RX_TIMEOUT_MS     60U        /**< 3 x 20 ms              */

/* ===== UDS diagnostics (FR-UDS-001..005) ===== */
#define UDS_DID_TTC           0xF100U    /**< DID — TTC value         */
#define UDS_DID_FSM_STATE     0xF101U    /**< DID — FSM state         */
#define UDS_DID_BRAKE_PRESS   0xF102U    /**< DID — Brake pressure    */
#define UDS_ROUTINE_AEB       0x0301U    /**< RID — AEB enable/disable*/

/* ===== Fault detection (FR-PER-006, FR-PER-007) ===== */
#define RADAR_DIST_MIN      0.5f    /* m                          */
#define RADAR_DIST_MAX      200.0f  /* m                          */
#define LIDAR_DIST_MIN      1.0f    /* m                          */
#define LIDAR_DIST_MAX      100.0f  /* m                          */
#define MAX_REL_VEL         50.0f   /* m/s                        */

/* ===== Kalman measurement noise ===== */
#define KALMAN_R_LIDAR      0.0025f /* m^2                        */
#define KALMAN_R_RADAR_D    0.09f   /* m^2                        */
#define KALMAN_R_RADAR_V    0.01f   /* (m/s)^2                    */

/* ===== Kalman process noise ===== */
#define KALMAN_Q_D          1e-4f   /* m^2                        */
#define KALMAN_Q_V          1e-5f   /* (m/s)^2                    */

/* ===== Kalman initial covariance ===== */
#define KALMAN_P0_D         1.0f    /* m^2                        */
#define KALMAN_P0_V         0.25f   /* (m/s)^2                    */

/* ===== Output clamping ===== */
#define DIST_MAX_OUTPUT     300.0f  /* m                          */
#define DIST_MIN_OUTPUT     0.5f    /* m                          */

#endif /* AEB_CONFIG_H */
```

## include/aeb_core.h
```c
/**
 * @file    aeb_core.h
 * @brief   AEB system core orchestrator — public API.
 * @module  Integration — 10 ms execution cycle
 * @version 1.0
 * @date    2026-04-10
 *
 * @details Wires all AEB modules into a single 10 ms execution cycle:
 *          Perception -> TTC -> FSM -> PID + Alert + Override -> CAN TX.
 *          Also runs UDS fault monitoring each cycle.
 *
 * @requirements FR-COD-001, NFR-PERF-001, NFR-POR-003
 */

#ifndef AEB_CORE_H
#define AEB_CORE_H

#include "aeb_types.h"
#include "aeb_can.h"
#include "aeb_uds.h"

/**
 * @brief Persistent state for the AEB core orchestrator.
 *
 * Holds all inter-module data structs and module-internal state
 * that persists across execution cycles.
 */
typedef struct
{
    /* Module outputs (inter-module data flow) */
    perception_output_t perception;
    ttc_output_t        ttc;
    fsm_output_t        fsm;
    pid_output_t        pid;
    alert_output_t      alert;

    /* Module-internal persistent state */
    can_state_t         can;
    uds_state_t         uds;

    /* Driver inputs (populated from CAN RX) */
    driver_input_t      driver;

    /* Override detection result */
    uint8_t             override_active;
} aeb_core_state_t;

/**
 * @brief Initialise the AEB system.
 *
 * Calls all module init functions and zeroes shared state.
 * Must be called once at power-on before the first cycle.
 *
 * @param[out] state  Pointer to core state (must not be NULL).
 * @return 0 on success, non-zero on CAN init failure.
 */
int32_t aeb_core_init(aeb_core_state_t *state);

/**
 * @brief Execute one 10 ms AEB cycle.
 *
 * Pipeline order:
 *   1.  CAN RX timeout check
 *   2.  Perception (sensor fusion + fault detection)
 *   3.  TTC and braking distance calculation
 *   4.  Override detection
 *   5.  FSM state evaluation
 *   6.  PID brake controller
 *   7.  Alert mapping
 *   8.  UDS fault monitoring
 *   9.  UDS request service (0x7DF → 0x7E8, FR-UDS-005)
 *   10. CAN TX (brake command, FSM state, alerts)
 *
 * @param[in,out] state  Pointer to core state.
 * @param[in]     raw    Raw sensor inputs for this cycle.
 */
void aeb_core_step(aeb_core_state_t *state,
                   const raw_sensor_input_t *raw);

#endif /* AEB_CORE_H */
```

## include/aeb_fsm.h
```c
/**
 * @file aeb_fsm.h
 * @brief 7-state Autonomous Emergency Braking Finite State Machine.
 * @author Lourenço Jamba Mphili
 * @requirements FR-FSM-001 to FR-FSM-006, FR-DEC-004 to FR-DEC-011
 */

#ifndef AEB_FSM_H
#define AEB_FSM_H

#include <stdint.h>
#include "aeb_types.h"
#include "aeb_config.h"

/**
 * @brief Initialize FSM internal state.
 * @param fsm_out Pointer to FSM output structure
 * @requirement FR-FSM-001 (Initial state = STANDBY)
 */
void fsm_init(fsm_output_t * const fsm_out);

/**
 * @brief Execute one step of the AEB FSM.
 * @param delta_t_s Time elapsed since last call [s] (typically AEB_DT = 0.01s)
 * @param perception Input from perception module
 * @param driver Input from driver inputs
 * @param ttc_in Precomputed TTC results
 * @param fsm_out Current/next FSM state (updated in-place)
 * @requirement FR-FSM-002, FR-FSM-003, FR-FSM-004, FR-FSM-005, FR-FSM-006
 */
void fsm_step(float32_t delta_t_s,
              const perception_output_t * const perception,
              const driver_input_t * const driver,
              const ttc_output_t * const ttc_in,
              fsm_output_t * const fsm_out);

#endif /* AEB_FSM_H */
```

## include/aeb_perception.h
```c
/**
 * @file  aeb_perception.h
 * @brief Public API for the AEB Perception module.
 */

#ifndef AEB_PERCEPTION_H
#define AEB_PERCEPTION_H

#include "aeb_types.h"


/** Reset all internal state. Call once before first perception_step(). */
void perception_init(void);

/** Execute one perception cycle (10 ms). */
void perception_step(const raw_sensor_input_t *in, perception_output_t *out);

#endif /* AEB_PERCEPTION_H */
```

## include/aeb_pid.h
```c
/**
 * @file    aeb_pid.h
 * @brief   PI brake controller module — public API.
 * @module  Execution — PID braking controller
 * @version 1.1
 * @date    2026-04-10
 *
 * @details Implements a PI controller with anti-windup and jerk limiting
 *          to generate smooth brake commands based on FSM deceleration targets.
 *          Derived from Simulink chart_96 (PID_Logic).
 *
 * @requirements FR-BRK-001 to FR-BRK-007
 * @simulink     chart_96 (PID_Logic) — system_150.xml
 */

#ifndef AEB_PID_H
#define AEB_PID_H

#include "aeb_types.h"

/**
 * @brief Initialise PID controller internal state.
 *
 * Resets integrator accumulator, previous brake output, and all flags.
 * Must be called once at system startup before the first cycle.
 *
 * @requirement FR-BRK-002 (controller initialisation)
 */
void pid_init(void);

/**
 * @brief Execute one PI brake controller step.
 *
 * Computes brake command [0-100%] using PI control law with:
 *   - Proportional + integral action (Kp=10.0, Ki=0.05)
 *   - Anti-windup clamping on integral term [0, 50%]
 *   - Jerk limiting: |delta_output| <= MAX_JERK * (100/DECEL_L3) * dt
 *   - Output clamped to [0, 100%]
 *   - Conversion to brake pressure: bar = pct / 10
 *   - Controller reset when not in braking states
 *
 * @param[in]  decel_target  Target deceleration from FSM module [m/s^2].
 * @param[in]  a_ego         Current ego vehicle deceleration [m/s^2].
 * @param[in]  fsm_state     Current FSM state (fsm_state_e value).
 * @param[out] output        Pointer to PID output struct (must not be NULL).
 *
 * @requirement FR-BRK-001, FR-BRK-002, FR-BRK-003, FR-BRK-004,
 *              FR-BRK-005, FR-BRK-006, FR-BRK-007
 */
void pid_brake_step(const float32_t decel_target, const float32_t a_ego,
                    const uint8_t fsm_state, pid_output_t *output);

#endif /* AEB_PID_H */
```

## include/aeb_ttc.h
```c
/**
 * @file aeb_ttc.h
 * @brief TTC (Time-to-Collision) and braking distance calculation.
 * @author Lourenço Jamba Mphili
 * @requirements FR-DEC-001, FR-DEC-002, FR-DEC-003
 */

#ifndef AEB_TTC_H
#define AEB_TTC_H

#include <stdint.h>
#include "aeb_types.h"
#include "aeb_config.h"

/**
 * @brief Calculates Time-to-Collision.
 * @param distance Distance to target [m]
 * @param v_rel Relative velocity (ego - target) [m/s]
 * @return TTC clamped to [0, TTC_MAX] seconds
 * @requirement FR-DEC-001
 */
float32_t ttc_calc(float32_t distance, float32_t v_rel);

/**
 * @brief Calculates minimum braking distance.
 * @param v_ego Ego vehicle speed [m/s]
 * @return d_brake = v² / (2 * DECEL_L3) [m]
 * @requirement FR-DEC-002
 */
float32_t d_brake_calc(float32_t v_ego);

/**
 * @brief Processes perception data and fills TTC output.
 * @param perception Input from perception module (contains distance, v_ego, v_rel)
 * @param ttc_out Output structure (defined in aeb_types.h)
 * @requirement FR-DEC-003
 */
void ttc_process(const perception_output_t * const perception,
                 ttc_output_t * const ttc_out);

#endif /* AEB_TTC_H */
```

## include/aeb_types.h
```c
/**
 * @file  aeb_types.h
 * @brief Shared interface structs for the AEB system.
 *
 * This file is the integration contract between all modules.
 * All modules communicate through typed structs passed by pointer.
 * No global mutable state except where Zephyr kernel objects require it.
 *
 * Based on AEB_Tasks v1.0 Section 3.1.
 *
 * @req FR-COD-001 Structural correspondence with Simulink model.
 * @req NFR-COD-005 Exclusive use of fixed-width types.
 *
 * @version 2.1 — Review fixes
 * @date 2026-04
 */

#ifndef AEB_TYPES_H
#define AEB_TYPES_H

#include <stdint.h>

/** @brief 32-bit IEEE-754 floating-point type (MISRA fixed-width). */
typedef float float32_t;

/**
 * @brief Perception output (Perception -> Decision).
 * @req FR-PER-001..008
 */
typedef struct
{
    float32_t distance;       /**< [0, 300] m              */
    float32_t v_ego;          /**< m/s                     */
    float32_t v_rel;          /**< m/s (>0 = closing)      */
    float32_t confidence;     /**< [0.0, 1.0]              */
    uint8_t   fault_flag;     /**< 0=OK, 1=fault           */
} perception_output_t;

/**
 * @brief TTC calculation output (Decision internal).
 * @req FR-DEC-001, FR-DEC-002
 */
typedef struct
{
    float32_t ttc;            /**< [0, 10] s               */
    float32_t d_brake;        /**< m                       */
    uint8_t   is_closing;     /**< boolean                 */
} ttc_output_t;

/**
 * @brief FSM output (Decision -> Execution, CAN, UDS).
 * @req FR-FSM-001
 */
typedef struct
{
    uint8_t   fsm_state;      /**< 0=OFF .. 6=POST_BRAKE   */
    float32_t decel_target;   /**< m/s^2                   */
    uint8_t   brake_active;   /**< boolean                 */
    uint8_t   alert_level;    /**< 0=none .. 3=critical    */
    float32_t warn_timer;     /**< s                       */
    float32_t state_timer;    /**< s                       */
} fsm_output_t;

/**
 * @brief PID brake output (PID brake -> CAN TX).
 * @req FR-BRK-007
 */
typedef struct
{
    float32_t brake_pct;      /**< [0, 100] %              */
    float32_t brake_bar;      /**< [0, 10] bar             */
} pid_output_t;

/**
 * @brief Alert output (Alert logic -> GPIO).
 * @req FR-ALR-001, FR-ALR-002
 */
typedef struct
{
    uint8_t   alert_type;     /**< 0=NONE,1=VIS,2=AUD,3=BOTH */
    uint8_t   alert_active;   /**< boolean                 */
    uint8_t   buzzer_cmd;     /**< 0..4 (beep pattern)     */
} alert_output_t;

/**
 * @brief Driver inputs (CAN RX -> Decision, Execution).
 * @req FR-PER-004, FR-PER-005, FR-PER-008
 */
typedef struct
{
    uint8_t   brake_pedal;    /**< boolean                 */
    uint8_t   accel_pedal;    /**< boolean                 */
    float32_t steering_angle; /**< degrees                 */
    uint8_t   aeb_enabled;    /**< boolean                 */
} driver_input_t;

/**
 * @brief FSM state enumeration.
 * @req FR-FSM-001
 */
typedef enum
{
    FSM_OFF        = 0,
    FSM_STANDBY    = 1,
    FSM_WARNING    = 2,
    FSM_BRAKE_L1   = 3,
    FSM_BRAKE_L2   = 4,
    FSM_BRAKE_L3   = 5,
    FSM_POST_BRAKE = 6
} fsm_state_e;

/* fault_flag bit positions */
#define AEB_FAULT_LIDAR    ((uint8_t)0x01U)
#define AEB_FAULT_RADAR    ((uint8_t)0x02U)
#define AEB_FAULT_CAN_TO   ((uint8_t)0x80U)


/**
 * @brief Raw sensor input (CAN RX / test harness -> Perception).
 * @req FR-PER-001, FR-PER-002, FR-PER-003
 */
typedef struct
{
    float32_t radar_d;        /**< Radar distance [m]              */
    float32_t radar_vr;       /**< Radar relative velocity [m/s]   */
    float32_t lidar_d;        /**< LiDAR distance [m]              */
    float32_t v_ego;          /**< Ego vehicle speed [m/s]         */
    uint8_t   can_timeout;    /**< CAN frame missed deadline       */
    uint8_t   fi;             /**< Fault injection (V&V only)      */
} raw_sensor_input_t;

#endif /* AEB_TYPES_H */
```

## include/aeb_uds.h
```c
/**
 * @file aeb_uds.h
 * @brief UDS Diagnostics module API for the AEB system.
 *
 * Implements the UDS server: live data access (SID 0x22), DTC management
 * (SID 0x14), fault monitoring, and AEB enable/disable (SID 0x31).
 *
 * @req FR-UDS-001 ReadDataByIdentifier (SID 0x22).
 * @req FR-UDS-002 DTC storage (C1001, C1004, C1006).
 * @req FR-UDS-003 ClearDiagnosticInformation (SID 0x14).
 * @req FR-UDS-004 RoutineControl (SID 0x31, routine 0x0301).
 * @req FR-UDS-005 UDS request/response via CAN within one cycle.
 * @req FR-COD-001 Structural correspondence with Simulink model.
 *
 * @author  Rian Linhares
 * @version 1.0
 * @date 2026-04
 */

#ifndef AEB_UDS_H
#define AEB_UDS_H

#include <stdint.h>
#include "aeb_types.h"

/* ===================================================================
 * UDS Service Identifiers (ISO 14229)
 * =================================================================== */

#define UDS_SID_READ_DID            ((uint8_t)0x22U)
#define UDS_SID_READ_DID_RESP       ((uint8_t)0x62U)
#define UDS_SID_CLEAR_DTC           ((uint8_t)0x14U)
#define UDS_SID_CLEAR_DTC_RESP      ((uint8_t)0x54U)
#define UDS_SID_ROUTINE_CTRL        ((uint8_t)0x31U)
#define UDS_SID_ROUTINE_CTRL_RESP   ((uint8_t)0x71U)
#define UDS_SID_NEGATIVE_RESP       ((uint8_t)0x7FU)

/* ===================================================================
 * Negative Response Codes (NRC)
 * =================================================================== */

#define UDS_NRC_SERVICE_NOT_SUPP    ((uint8_t)0x11U)
#define UDS_NRC_REQUEST_OOR         ((uint8_t)0x31U)

/* ===================================================================
 * DID Identifiers
 * =================================================================== */

#define UDS_DID_TTC_VAL             ((uint16_t)0xF100U)
#define UDS_DID_FSM_STATE_VAL       ((uint16_t)0xF101U)
#define UDS_DID_BRAKE_PRESS_VAL     ((uint16_t)0xF102U)

/* ===================================================================
 * Routine Identifiers
 * =================================================================== */

#define UDS_RID_AEB_CTRL            ((uint16_t)0x0301U)

/* ===================================================================
 * Data Structures
 * =================================================================== */

/**
 * @brief UDS request — maps to UDS_Request CAN msg (ID 0x7DF / 2015).
 */
typedef struct
{
    uint8_t sid;        /**< Service Identifier                       */
    uint8_t did_high;   /**< DID high byte                            */
    uint8_t did_low;    /**< DID low byte                             */
    uint8_t value;      /**< Value field (RoutineControl)             */
} uds_request_t;

/**
 * @brief UDS response — maps to UDS_Response CAN msg (ID 0x7E8 / 2024).
 */
typedef struct
{
    uint8_t response_sid;   /**< Response SID                         */
    uint8_t did_high_resp;  /**< DID high byte (echo or SID for NRC)  */
    uint8_t did_low_resp;   /**< DID low byte (or NRC code)           */
    uint8_t data1;          /**< Response data byte 1                 */
    uint8_t data2;          /**< Response data byte 2                 */
    uint8_t data3;          /**< Response data byte 3                 */
    uint8_t data4;          /**< Response data byte 4                 */
    uint8_t data5;          /**< Response data byte 5                 */
} uds_response_t;

/**
 * @brief UDS server internal state (persistent variables).
 *
 * Maps to MATLAB Function persistent variables:
 *   aeb_enabled_mem, dtc_sensor_mem, dtc_crc_mem, dtc_actuator_mem.
 */
typedef struct
{
    uint8_t aeb_enabled;    /**< AEB enable flag (persistent)          */
    uint8_t dtc_sensor;     /**< DTC C1001: sensor fault (latched)     */
    uint8_t dtc_crc;        /**< DTC C1004: CRC error (latched)        */
    uint8_t dtc_actuator;   /**< DTC C1006: actuator fault (latched)   */
} uds_state_t;

/**
 * @brief UDS server output signals.
 */
typedef struct
{
    uint8_t aeb_enabled;    /**< Current AEB enable state              */
    uint8_t dtc_count;      /**< Number of active DTCs (0..3)          */
    uint8_t fault_lamp;     /**< MIL lamp: 1 if dtc_count > 0         */
} uds_output_t;

/* ===================================================================
 * Public API
 * =================================================================== */

/**
 * @brief Initialise the UDS server state.
 * @param[out] state  Pointer to UDS state to initialise.
 * @req NFR-SAF-004 Power-on self-test.
 */
void uds_init(uds_state_t *state);

/**
 * @brief Monitor fault inputs and latch DTCs (called every 10 ms).
 *
 * DTCs stored immediately on first active fault (DD-UDS-01, no debounce).
 *
 * @param[in,out] state          UDS server state.
 * @param[in]     sensor_fault   Sensor fault flag (0/1).
 * @param[in]     crc_error      CRC error flag (0/1).
 * @param[in]     actuator_fault Actuator fault flag (0/1).
 * @req FR-UDS-002
 */
void uds_monitor_faults(uds_state_t *state,
                        uint8_t sensor_fault,
                        uint8_t crc_error,
                        uint8_t actuator_fault);

/**
 * @brief Process a UDS request and generate the response.
 *
 * @param[in,out] state    UDS server state.
 * @param[in]     request  Incoming UDS request.
 * @param[out]    response UDS response to populate.
 * @param[in]     fsm_out  Current FSM output (live data).
 * @param[in]     pid_out  Current PID output (live data).
 * @param[in]     ttc_out  Current TTC output (live data).
 * @req FR-UDS-001, FR-UDS-003, FR-UDS-004, FR-UDS-005
 */
void uds_process_request(uds_state_t *state,
                         const uds_request_t *request,
                         uds_response_t *response,
                         const fsm_output_t *fsm_out,
                         const pid_output_t *pid_out,
                         const ttc_output_t *ttc_out);

/**
 * @brief Get current UDS output signals.
 * @param[in]  state  UDS server state.
 * @param[out] output Output structure to populate.
 */
void uds_get_output(const uds_state_t *state, uds_output_t *output);

#endif /* AEB_UDS_H */
```
